// Inverter switching signal source (see inverter.h)
//
// PWM: slices of U/V/W in phase-correct (triangle carrier) mode, started together so
// the carriers are aligned. The wrap IRQ of the U slice runs once per carrier period
// and writes the next compare values from a 1024-point Q15 sine table.
//
// Gate driver: IR2302. IN=High -> high side on, IN=Low -> low side on, dead time
// (~540 ns) is generated by the driver. SD is active low and shared by all drivers.

#include "inverter.h"
#include <math.h>
#include <string.h>
#include <stdlib.h>
#include "hardware/pwm.h"
#include "hardware/gpio.h"
#include "hardware/irq.h"

// ---- pins (change here only) ----
#define PIN_U      4    // slice 2 A
#define PIN_V      6    // slice 3 A
#define PIN_W      8    // slice 4 A
#define PIN_SD     10   // active low, external 10k pull-down
#define PIN_ESTOP  11   // active low switch, internal pull-up

// ---- limits ----
#define FC_MIN          10000.0
#define FC_MAX          120000.0
#define F1_MIN          1.0
#define F1_MAX          1500.0
#define CARRIER_RATIO   8.0       // carrier must be >= 8x the fundamental / audio bandwidth
#define M_MAX           0.8       // modulation index limit
#define M_DC_MAX        0.3       // DC excitation: current is limited only by winding resistance
#define DUTY_MIN        0.02      // keep the low side on every period (bootstrap)
#define T_LOW_MIN       1.0e-6    // and at least this long (IR2302 dead time 540 ns + margin)
#define M_RAMP_PER_S    2.0       // amplitude ramp
#define ACCEL_DEFAULT   100.0     // Hz/s
#define DC_SLEW_DEG_S   90.0      // DC angle slew rate
#define DC_TIMEOUT_DEF  10.0
#define DC_TIMEOUT_MAX  60.0
#define PRECHARGE_MS    10
#define AUDIO_FS_MIN    4000.0
#define AUDIO_FS_MAX    48000.0
#define AUDIO_IDLE_MS   1500      // no audio data for this long -> stop playback
#define AUD_REPORT_MS   50
#define AUDIO_PRIME     2048      // samples buffered before playback (re)starts

#define LUT_BITS   10
#define LUT_SIZE   (1 << LUT_BITS)
#define RING_BITS  15
#define RING_SIZE  (1u << RING_BITS)   // int16 samples (64 KB)
#define RING_MASK  (RING_SIZE - 1)
#define PH_120     0x55555555u          // 120 deg in 32-bit phase

enum State { S_OFF, S_PRECHARGE, S_IDLE, S_RUN, S_DC, S_AUDIO, S_RAMPDOWN, S_FAULT };
static const char *STATE_NAMES[] = {"OFF", "PRECHARGE", "IDLE", "RUN", "DC", "AUDIO", "RAMPDOWN", "FAULT"};
enum Src : uint8_t { SRC_LOW, SRC_SINE, SRC_AUDIO };   // what the IRQ outputs

static uint32_t sysHz;
static uint sliceU, sliceV, sliceW;
static uint32_t sliceMask;

// ---- shared with the IRQ ----
static int16_t sinLut[LUT_SIZE];
static int16_t ring[RING_SIZE];
static volatile uint32_t isrTheta, isrStep;   // electrical angle accumulator / increment
static volatile int32_t isrM;                 // amplitude, Q15
static volatile uint8_t isrSrc = SRC_LOW;
static volatile bool isr3P = true, isrRev = false;
static volatile uint32_t ccFull, ccMin, ccMax;
static volatile uint32_t audW, audR, audFrac, audStep, audUnder;   // audUnder: buffer ran dry
static volatile bool audPlaying;                                    // false while (re)priming

// ---- main-loop state ----
static State state = S_OFF;
static bool mode3P = true;
static bool rev = false;
static double fcSet = 20000, fcAct = 20000, dmin = DUTY_MIN;
static uint32_t top1 = 5000;                  // TOP + 1
static double fCur = 0, fTgt = 0, accel = ACCEL_DEFAULT;
static double mCur = 0, mTgt = 0;
static uint32_t dcTarget = 0;
static uint32_t dcDeadline = 0;
static State afterRamp = S_IDLE;              // where a ramp to m=0 ends
static uint32_t prechargeAt = 0;
static volatile bool estopTripped = false;
static const char *faultReason = "NONE";
static double audFs = 0, audBw = 0;
static uint32_t audLastData = 0, audLastReport = 0, audDrop = 0;

// =====================================================================
// IRQ
// =====================================================================
static inline uint32_t __not_in_flash_func(toCc)(int32_t v) {   // v: Q15 (-1..1)
  // ccFull <= 10000 and (32768 + v) <= 65536, so the product fits in 32 bits
  int32_t cc = (int32_t)((ccFull * (uint32_t)(32768 + v)) >> 16);
  if (cc < (int32_t)ccMin) cc = ccMin;
  if (cc > (int32_t)ccMax) cc = ccMax;
  return (uint32_t)cc;
}

static inline int32_t __not_in_flash_func(sinQ15)(uint32_t ph) { return sinLut[ph >> (32 - LUT_BITS)]; }

static void __not_in_flash_func(invIsr)() {
  if (!(pwm_get_irq_status_mask() & (1u << sliceU))) return;
  pwm_clear_irq(sliceU);

  uint32_t ccU, ccV, ccW;
  int32_t m = isrM;
  switch (isrSrc) {
    case SRC_SINE: {
      uint32_t th = isrTheta + isrStep;
      isrTheta = th;
      int32_t vU = (m * sinQ15(th)) >> 15;
      if (isr3P) {
        int32_t vB = (m * sinQ15(th - PH_120)) >> 15;
        int32_t vC = (m * sinQ15(th + PH_120)) >> 15;
        ccU = toCc(vU);
        ccV = toCc(isrRev ? vC : vB);
        ccW = toCc(isrRev ? vB : vC);
      } else {
        ccU = toCc(vU);
        ccV = toCc(-vU);
        ccW = 0;
      }
      break;
    }
    case SRC_AUDIO: {
      int32_t s = 0;
      uint32_t r = audR;
      if (audPlaying && audW - r >= 2) {
        int32_t s0 = ring[r & RING_MASK], s1 = ring[(r + 1) & RING_MASK];
        s = s0 + (((s1 - s0) * (int32_t)(audFrac >> 18)) >> 14);   // linear interpolation
        uint32_t nf = audFrac + audStep;
        if (nf < audFrac) audR = r + 1;
        audFrac = nf;
      } else if (audPlaying) {
        audPlaying = false;      // ran dry: output silence until re-primed
        audUnder++;
      }
      int32_t v = (m * s) >> 15;
      ccU = toCc(v);
      ccV = toCc(-v);
      ccW = 0;
      break;
    }
    default:   // SRC_LOW: all low sides on (bootstrap precharge)
      ccU = ccV = ccW = 0;
      break;
  }
  pwm_set_chan_level(sliceU, PWM_CHAN_A, ccU);
  pwm_set_chan_level(sliceV, PWM_CHAN_A, ccV);
  pwm_set_chan_level(sliceW, PWM_CHAN_A, ccW);
}

// =====================================================================
// low level output control
// =====================================================================
static void pinsLow() {
  const uint pins[] = {PIN_U, PIN_V, PIN_W};
  for (uint p : pins) {
    gpio_set_function(p, GPIO_FUNC_SIO);
    gpio_set_dir(p, GPIO_OUT);
    gpio_put(p, 0);
  }
}

// immediate hardware stop: SD low first, then PWM off
static void __not_in_flash_func(hardStop)() {
  gpio_put(PIN_SD, 0);
  hw_clear_bits(&pwm_hw->en, sliceMask);
  pwm_set_irq_enabled(sliceU, false);
  isrSrc = SRC_LOW;
  isrM = 0;
}

static void estopIsr() {
  hardStop();
  estopTripped = true;
}

static void applyCarrier() {
  top1 = (uint32_t)lround((double)sysHz / (2.0 * fcSet));
  fcAct = (double)sysHz / (2.0 * top1);
  dmin = DUTY_MIN;
  if (T_LOW_MIN * fcAct > dmin) dmin = T_LOW_MIN * fcAct;
  uint32_t lo = (uint32_t)ceil(dmin * top1);
  ccFull = top1;
  ccMin = lo;
  ccMax = top1 - lo;
}

// configure the three slices and start them on the same clock edge
static void startPwm() {
  hw_clear_bits(&pwm_hw->en, sliceMask);
  const uint slices[] = {sliceU, sliceV, sliceW};
  for (uint s : slices) {
    pwm_config cfg = pwm_get_default_config();
    pwm_config_set_phase_correct(&cfg, true);
    pwm_config_set_clkdiv_int(&cfg, 1);
    pwm_config_set_wrap(&cfg, top1 - 1);
    pwm_init(s, &cfg, false);
    pwm_set_chan_level(s, PWM_CHAN_A, 0);
    pwm_set_counter(s, 0);
  }
  gpio_set_function(PIN_U, GPIO_FUNC_PWM);
  gpio_set_function(PIN_V, GPIO_FUNC_PWM);
  gpio_set_function(PIN_W, GPIO_FUNC_PWM);
  pwm_clear_irq(sliceU);
  pwm_set_irq_enabled(sliceU, true);
  hw_set_bits(&pwm_hw->en, sliceMask);   // do not touch the other slices (CH1 / CH2)
}

static void goOff() {
  hardStop();
  pinsLow();
  state = S_OFF;
  fCur = fTgt = mCur = mTgt = 0;
  isrStep = 0;
}

static void beginRampDown(State next) {
  mTgt = 0;
  afterRamp = next;
  state = S_RAMPDOWN;
}

// =====================================================================
// reporting
// =====================================================================
void invReport() {
  uint32_t theta = isrTheta;
  String line = "OK INV state=";
  line += STATE_NAMES[state];
  line += " mode=";      line += mode3P ? "3P" : "1P";
  line += " fc=";        line += String(fcAct, 1);
  line += " top=";       line += top1;
  line += " f=";         line += String(fCur, 3);
  line += " ftgt=";      line += String(fTgt, 3);
  line += " m=";         line += String(mCur, 3);
  line += " mtgt=";      line += String(mTgt, 3);
  line += " theta=";     line += String(theta * (360.0 / 4294967296.0), 1);
  line += " dir=";       line += rev ? "REV" : "FWD";
  line += " sd=";        line += gpio_get(PIN_SD) ? 1 : 0;
  line += " fault=";     line += faultReason;
  line += " estop=";     line += gpio_get(PIN_ESTOP) ? 0 : 1;
  line += " dmin=";      line += String(dmin * 100.0, 2);
  line += " accel=";     line += String(accel, 1);
  if (state == S_DC) {
    line += " dcleft=";
    line += String(((int32_t)(dcDeadline - millis())) / 1000.0, 1);
  }
  if (state == S_AUDIO || (state == S_RAMPDOWN && isrSrc == SRC_AUDIO)) {
    line += " fs=";  line += String(audFs, 1);
    line += " bw=";  line += String(audBw, 1);
  }
  Serial.println(line);
}

static void err(const char *msg) {
  Serial.print("ERR INV ");
  Serial.println(msg);
}

// =====================================================================
// public
// =====================================================================
void invInit(uint32_t hz) {
  sysHz = hz;
  // SD low before anything else
  gpio_init(PIN_SD);
  gpio_set_dir(PIN_SD, GPIO_OUT);
  gpio_put(PIN_SD, 0);
  gpio_init(PIN_U);
  gpio_init(PIN_V);
  gpio_init(PIN_W);
  pinsLow();

  sliceU = pwm_gpio_to_slice_num(PIN_U);
  sliceV = pwm_gpio_to_slice_num(PIN_V);
  sliceW = pwm_gpio_to_slice_num(PIN_W);
  sliceMask = (1u << sliceU) | (1u << sliceV) | (1u << sliceW);

  for (int i = 0; i < LUT_SIZE; i++)
    sinLut[i] = (int16_t)lround(32767.0 * sin(2.0 * M_PI * i / LUT_SIZE));

  applyCarrier();
  irq_add_shared_handler(PWM_IRQ_WRAP, invIsr, PICO_SHARED_IRQ_HANDLER_HIGHEST_ORDER_PRIORITY);
  irq_set_priority(PWM_IRQ_WRAP, 0);
  irq_set_enabled(PWM_IRQ_WRAP, true);

  pinMode(PIN_ESTOP, INPUT_PULLUP);
  attachInterrupt(digitalPinToInterrupt(PIN_ESTOP), estopIsr, FALLING);
}

bool invActive() { return state != S_OFF && state != S_FAULT; }
bool invFault() { return state == S_FAULT; }
void invSetTheta(uint32_t t) { isrTheta = t; }
uint32_t invGetTheta() { return isrTheta; }

void invOnHostDisconnect() {
  if (state == S_OFF || state == S_FAULT) return;
  if (state == S_PRECHARGE) goOff();
  else beginRampDown(S_OFF);
}

void invAudioData(const int16_t *s, size_t n) {
  if (state != S_AUDIO) return;
  uint32_t w = audW;
  uint32_t space = RING_SIZE - 1 - (w - audR);
  if (n > space) {
    audDrop += n - space;
    n = space;
  }
  for (size_t i = 0; i < n; i++) ring[(w + i) & RING_MASK] = s[i];
  audW = w + n;
  audLastData = millis();
  if (!audPlaying && audW - audR >= AUDIO_PRIME) audPlaying = true;
}

void invPoll() {
  static uint32_t lastUs = micros();
  uint32_t now = micros();
  double dt = (now - lastUs) * 1e-6;
  if (dt < 0.001) return;   // ~1 kHz
  lastUs = now;

  // e-stop (edge IRQ already stopped the hardware; also catch a held-low switch)
  if (estopTripped || (!gpio_get(PIN_ESTOP) && invActive())) {
    estopTripped = false;
    if (state != S_FAULT && state != S_OFF) {
      hardStop();
      pinsLow();
      state = S_FAULT;
      faultReason = "ESTOP";
      fCur = fTgt = mCur = mTgt = 0;
      isrStep = 0;
      Serial.println("EVT INV FAULT ESTOP");
      invReport();
    }
  }

  switch (state) {
    case S_PRECHARGE:
      if (millis() - prechargeAt >= PRECHARGE_MS) {
        mCur = mTgt = 0;
        isrM = 0;
        isrStep = 0;
        isrSrc = SRC_SINE;    // m = 0 -> every leg at 50 %
        state = S_IDLE;
        invReport();
      }
      return;
    case S_DC: {
      // slew the angle toward the target
      int32_t diff = (int32_t)(dcTarget - isrTheta);
      int32_t maxStep = (int32_t)(DC_SLEW_DEG_S / 360.0 * 4294967296.0 * dt);
      if (diff > maxStep) diff = maxStep;
      if (diff < -maxStep) diff = -maxStep;
      isrTheta = isrTheta + diff;
      if ((int32_t)(millis() - dcDeadline) >= 0) {
        Serial.println("EVT INV DC TIMEOUT");
        beginRampDown(S_IDLE);
      }
      break;
    }
    case S_AUDIO: {
      uint32_t ms = millis();
      if (ms - audLastReport >= AUD_REPORT_MS) {
        audLastReport = ms;
        uint32_t fill = audW - audR;
        Serial.printf("AUD fill=%lu free=%lu under=%lu drop=%lu\n", (unsigned long)fill,
                      (unsigned long)(RING_SIZE - 1 - fill), (unsigned long)audUnder,
                      (unsigned long)audDrop);
      }
      // short clip (less than AUDIO_PRIME): play what we have once data stops
      if (!audPlaying && audW - audR >= 2 && ms - audLastData >= 100) audPlaying = true;
      if (ms - audLastData >= AUDIO_IDLE_MS && audW - audR < 2) {
        Serial.println("EVT INV AUDIO END");
        beginRampDown(S_IDLE);
      }
      break;
    }
    default:
      break;
  }

  if (state == S_RUN || state == S_DC || state == S_AUDIO || state == S_RAMPDOWN) {
    // amplitude ramp
    double step = M_RAMP_PER_S * dt;
    if (mCur < mTgt) mCur = fmin(mCur + step, mTgt);
    else if (mCur > mTgt) mCur = fmax(mCur - step, mTgt);
    isrM = (int32_t)lround(mCur * 32768.0);
    // frequency ramp
    if (state == S_RUN) {
      double fs = accel * dt;
      if (fCur < fTgt) fCur = fmin(fCur + fs, fTgt);
      else if (fCur > fTgt) fCur = fmax(fCur - fs, fTgt);
      isrStep = (uint32_t)(fCur / fcAct * 4294967296.0);
    }
    if (state == S_RAMPDOWN && mCur <= 0.0) {
      isrStep = 0;
      fCur = fTgt = 0;
      if (afterRamp == S_OFF) {
        goOff();
      } else {
        isrSrc = SRC_SINE;
        state = S_IDLE;
      }
      invReport();
    }
  }
}

// =====================================================================
// commands
// =====================================================================
static char *tok() { return strtok(nullptr, " \t"); }
static bool num(char *t, double &out) {
  if (!t) return false;
  char *e;
  out = strtod(t, &e);
  return e != t;
}

void invHandleCommand() {
  char *sub = tok();
  if (!sub || !strcmp(sub, "STATUS")) {
    invReport();
    return;
  }

  if (!strcmp(sub, "MODE")) {
    char *a = tok();
    if (state != S_OFF) return err("disable first");
    if (a && !strcmp(a, "3P")) mode3P = true;
    else if (a && !strcmp(a, "1P")) mode3P = false;
    else return err("usage: INV MODE <3P|1P>");
    isr3P = mode3P;
    invReport();

  } else if (!strcmp(sub, "CARRIER")) {
    double fc;
    if (!num(tok(), fc)) return err("usage: INV CARRIER <hz>");
    if (fc < FC_MIN || fc > FC_MAX) return err("carrier out of range 10000-120000");
    if (state != S_OFF && state != S_IDLE) return err("stop first");
    fcSet = fc;
    applyCarrier();
    if (state == S_IDLE) startPwm();   // re-sync the three carriers
    invReport();

  } else if (!strcmp(sub, "ENABLE")) {
    if (!gpio_get(PIN_ESTOP)) return err("estop pressed");
    if (state != S_OFF && state != S_FAULT) return invReport();
    faultReason = "NONE";
    estopTripped = false;
    isrSrc = SRC_LOW;
    isrM = 0;
    isrStep = 0;
    isr3P = mode3P;
    isrRev = rev;
    startPwm();                 // all IN low = all low sides on
    gpio_put(PIN_SD, 1);        // charge bootstrap capacitors for PRECHARGE_MS
    prechargeAt = millis();
    state = S_PRECHARGE;
    invReport();

  } else if (!strcmp(sub, "DISABLE")) {
    if (state == S_OFF || state == S_FAULT || state == S_PRECHARGE || state == S_IDLE) {
      goOff();
      faultReason = "NONE";
    } else {
      beginRampDown(S_OFF);
    }
    invReport();

  } else if (!strcmp(sub, "STOP")) {
    if (state == S_RUN || state == S_DC || state == S_AUDIO) beginRampDown(S_IDLE);
    invReport();

  } else if (!strcmp(sub, "DIR")) {
    char *a = tok();
    if (state == S_RUN || state == S_RAMPDOWN) return err("stop first");
    if (a && !strcmp(a, "FWD")) rev = false;
    else if (a && !strcmp(a, "REV")) rev = true;
    else return err("usage: INV DIR <FWD|REV>");
    isrRev = rev;
    invReport();

  } else if (!strcmp(sub, "RUN")) {
    double f, m, a = accel;
    if (!num(tok(), f) || !num(tok(), m)) return err("usage: INV RUN <f_hz> <m> [accel_hz_s]");
    char *ta = tok();
    if (ta && !num(ta, a)) return err("bad accel");
    if (f < F1_MIN || f > F1_MAX) return err("f out of range 1-1500");
    if (m < 0 || m > M_MAX) return err("m out of range 0-0.8");
    if (a < 0.1 || a > 100000) return err("accel out of range 0.1-100000");
    if (fcAct < CARRIER_RATIO * f) return err("carrier must be >= 8x fundamental");
    if (state != S_IDLE && state != S_RUN && state != S_DC) return err("not ready (enable first)");
    if (state == S_DC) fCur = 0;   // start from the aligned angle
    accel = a;
    fTgt = f;
    mTgt = m;
    isrSrc = SRC_SINE;
    state = S_RUN;
    invReport();

  } else if (!strcmp(sub, "DC")) {
    double deg, m, to = DC_TIMEOUT_DEF;
    if (!num(tok(), deg) || !num(tok(), m)) return err("usage: INV DC <deg> <m> [timeout_s]");
    char *tt = tok();
    if (tt && !num(tt, to)) return err("bad timeout");
    if (!mode3P) return err("DC excitation is 3P only");
    if (m < 0 || m > M_DC_MAX) return err("m out of range 0-0.3 for DC");
    if (to < 1 || to > DC_TIMEOUT_MAX) return err("timeout out of range 1-60");
    if (state != S_IDLE && state != S_DC) return err("not ready (enable / stop first)");
    deg = fmod(deg, 360.0);
    if (deg < 0) deg += 360.0;
    dcTarget = (uint32_t)(deg / 360.0 * 4294967296.0);
    if (state == S_IDLE) isrTheta = dcTarget;   // first time: jump (m ramps from 0)
    dcDeadline = millis() + (uint32_t)(to * 1000);
    fCur = fTgt = 0;
    isrStep = 0;
    mTgt = m;
    isrSrc = SRC_SINE;
    state = S_DC;
    invReport();

  } else if (!strcmp(sub, "AUDIO")) {
    char *a = tok();
    if (a && !strcmp(a, "STOP")) {
      if (state == S_AUDIO) beginRampDown(S_IDLE);
      invReport();
      return;
    }
    double fs, bw, m;
    if (!a || strcmp(a, "START") || !num(tok(), fs) || !num(tok(), bw) || !num(tok(), m))
      return err("usage: INV AUDIO START <fs> <bw> <m> | INV AUDIO STOP");
    if (mode3P) return err("audio is 1P only");
    if (fs < AUDIO_FS_MIN || fs > AUDIO_FS_MAX) return err("fs out of range 4000-48000");
    if (bw <= 0 || bw > fs / 2) return err("bw must be 0 < bw <= fs/2");
    if (m < 0 || m > M_MAX) return err("m out of range 0-0.8");
    if (fcAct < CARRIER_RATIO * bw) return err("carrier must be >= 8x audio bandwidth");
    if (state != S_IDLE && state != S_AUDIO) return err("not ready (enable / stop first)");
    if (state == S_IDLE) {
      audW = audR = audFrac = audUnder = audDrop = 0;
      audPlaying = false;
      audStep = (uint32_t)(fs / fcAct * 4294967296.0);
      audFs = fs;
      audBw = bw;
      audLastData = audLastReport = millis();
      isrSrc = SRC_AUDIO;
      state = S_AUDIO;
    }
    mTgt = m;                    // while playing: volume change only
    invReport();

  } else {
    err("unknown INV command");
  }
}
